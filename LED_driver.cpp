#include "LED_driver.h"
byte msg[16][MSG_LONG] =
{
    {0x00, 0x80, 0x00, 0x00, 0x10, 0x40, 0x00, 0x08},
    {0x00, 0x80, 0x41, 0x84, 0x10, 0x44, 0x3f, 0xfc},
    {0xfc, 0x80, 0x26, 0x7e, 0x1f, 0xfe, 0x21, 0x08},
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    {0x0c, 0x04, 0x00, 0x00, 0x28, 0x04, 0x80, 0x10}
};
byte msg_offset = 0, msg_begin = 0, msg_long = 8;
void senddata(byte data)
{
    byte i;
    for(i = 0; i < 8; i++)
    {
        digitalWrite(CLK, 0);
        if(data & 0x80)
            digitalWrite(R1, 0);
        else
            digitalWrite(R1, 1);
        data = data << 1;
        digitalWrite(CLK, 1);
    }
}
void scan(byte row)
{
    digitalWrite(SignA, (row & 0x01));
    digitalWrite(SignB, (row & 0x02));
    digitalWrite(SignC, (row & 0x04));
    digitalWrite(SignD, (row & 0x08));
}
void show(void)
{
    byte i, j;
    if(!led_en)
        return;
    for(i = 0; i < 16; i++)
    {
        for(j = 0; j < 8; j++)
            senddata((msg[i][(msg_begin + j) % msg_long] << msg_offset) | (msg[i][(msg_begin + j + 1) % msg_long] >> (8 - msg_offset)));
        digitalWrite(EN, 1);
        scan(i);
        digitalWrite(LAT, 0);
        digitalWrite(LAT, 1);
        digitalWrite(EN, 0);
    }
}

